## conf/layer.conf
```bitbake
# We have a conf and classes directory, add to BBPATH
BBPATH .= ":${LAYERDIR}"

# We have recipes-* directories, add to BBFILES
BBFILES += "${LAYERDIR}/recipes-*/*/*.bb ${LAYERDIR}/recipes-*/*/*.bbappend"

BBFILE_COLLECTIONS += "ldms-layer"
BBFILE_PATTERN_ldms-layer = "^${LAYERDIR}/"
BBFILE_PRIORITY_ldms-layer = "95"

# LAYERDEPENDS_ldms-layer = " \
#     core \
#     freescale-layer \
#     fsl-arm-extra \
#     toradex-bsp-common-layer \
# "
```
